## drivers/falcon/Kconfig
```kconfig
#
# Falcon device driver configuration
#

menuconfig FALCON_DRV
	bool "Falcon device driver"
	depends on FALCON
	default n
	---help---
	  Say Y here to get to see options for various different falcon wrapper drivers.
	  This option alone does not add any kernel code.

	  If you say N, all options in this submenu will be skipped and disabled;
	  only do this if you know what you are doing.

if FALCON_DRV

config FALCON_WRAPPER
	bool "Falcon wrapper drivers"
	default n

choice FALCON_SHARED_STORAGE
	prompt "Falcon Shared Storage"
	depends on FALCON_WRAPPER

config FALCON_BLK
	bool "Falcon Block Storage Driver support"
	depends on BLK_DEV
	help
	  This enables the Block storage driver for Falcon.

config FALCON_BLK_BOOTPART
	bool "BootPartion support"
	default n
	depends on FALCON_BLK
	help
	  This enables BootPartion for the Block storage driver.

config FALCON_BLK_RPMB
	bool "RPMB support"
	default n
	depends on FALCON_BLK
	help
	  This enables RPMB for the Block storage driver.

config FALCON_BLK_MULTISEG
	bool "Use multi segments transfer"
	default y
	depends on FALCON_BLK
	help
	  Say Y here to use Bounce Buffer capability.

config FALCON_MTD_NAND
	bool "Falcon NAND Driver support"
	depends on MTD_NAND
	help
	  This enables the NAND storage driver for Falcon.

config FALCON_MTD_NOR
	bool "Falcon NOR Driver support"
	depends on MTD
	help
	  This enables the NOR storage driver for Falcon.

endchoice

endif # FALCON_DRV
```

## drivers/labutil/Kconfig
```kconfig
menu "Lab126 misc utils"

config LAB_UTILS
	bool "Lab126 MISC UTILS"
	default y
	help
	  Select this option to run lab utils

endmenu
```
